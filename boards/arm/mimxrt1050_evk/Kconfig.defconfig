## boards/arm/mimxrt1050_evk/Kconfig.defconfig
```kconfig
# Kconfig - MIMXRT1050-EVK board
#
# Copyright (c) 2017, NXP
#
# SPDX-License-Identifier: Apache-2.0
#

if BOARD_MIMXRT1050_EVK

config BOARD
	default mimxrt1050_evk

if GPIO_MCUX_IGPIO

config GPIO_MCUX_IGPIO_1
	def_bool y

config GPIO_MCUX_IGPIO_2
	def_bool n

config GPIO_MCUX_IGPIO_3
	def_bool n

config GPIO_MCUX_IGPIO_4
	def_bool n

config GPIO_MCUX_IGPIO_5
	def_bool y

endif # GPIO_MCUX_IGPIO

if UART_MCUX_LPUART

config UART_MCUX_LPUART_1
	def_bool y

endif # UART_MCUX_LPUART

if I2C_MCUX_LPI2C

config I2C_MCUX_LPI2C_1
	def_bool y

endif # I2C_MCUX_LPI2C

if FXOS8700

config FXOS8700_GPIO_NAME
	default GPIO_1

config FXOS8700_GPIO_PIN
	default 11

endif # FXOS8700

endif # BOARD_MIMXRT1050_EVK
```

## drivers/i2c/Kconfig.mcux_lpi2c
```kconfig
# Kconfig - MCUXpresso SDK I2C
#
# Copyright 2018, Nathan Tsoi <nathan@vertile.com>
#
# SPDX-License-Identifier: Apache-2.0

menuconfig I2C_MCUX_LPI2C
	bool "MCUX I2C driver"
	depends on HAS_MCUX
	default n
	select SERIAL_HAS_DRIVER
	help
	  Enable the MCUX I2C driver.

if I2C_MCUX_LPI2C

menuconfig I2C_MCUX_LPI2C_1
	bool "I2C 1"
	default n
	help
	  Enable I2C 1.

endif # I2C_MCUX_LPC
```

## dts/bindings/i2c/nxp,kinetis-lpi2c.yaml
```yaml
---
title: Kinetis LPI2C
id: nxp,kinetis-lpi2c
version: 0.1

description: >
    This binding gives a base representation of the Kinetis LPI2C

inherits:
    !include i2c.yaml

properties:
    compatible:
      type: string
      category: required
      description: compatible strings
      constraint: "nxp,kinetis-lpi2c"

    reg:
      type: array
      description: mmio register space
      generation: define
      category: required

    interrupts:
      type: array
      category: required
      description: required interrupts
      generation: define
```
